#include <EasyHID.h>      // Подключение библиотеки EasyHID для работы с HID-устройствами
#include <HIDPrivate.h>   // Подключение библиотеки HIDPrivate для работы с HID-устройствами
#include <usbconfig.h>    // Подключение конфигурации USB

int left;                  // Переменная для состояния первой педали
int middle;                  // Переменная для состояния второй педали
int right;                // Переменная для состояния третьей педали

void setup() {
  Serial.begin(9600);     // Инициализация последовательного соединения для мониторинга через Serial Monitor

  pinMode(10, INPUT_PULLUP);  // Настройка пина 10 как вход с подтягивающим резистором для первой педали
  pinMode(11, INPUT_PULLUP);  // Настройка пина 11 как вход с подтягивающим резистором для второй педали
  pinMode(12, INPUT_PULLUP);  // Настройка пина 12 как вход с подтягивающим резистором для третьей педали

  HID.begin();            // Инициализация HID-библиотеки
}

void loop() {
  HID.tick();             // Обновление состояния HID-устройства

  // Чтение состояния педалей (0 - не нажата, 1 - нажата)
  left = !digitalRead(10);   // Чтение состояния первой педали (инвертированное значение, так как используется INPUT_PULLUP)
  middle = !digitalRead(11);   // Чтение состояния второй педали
  right = !digitalRead(12); // Чтение состояния третьей педали

  // Обработка нажатия первой педали
  if (left == 1) {
    Keyboard.click(KEY_1);  // Отправка нажатия клавиши "1"
    Serial.println("left_pedal");    // Вывод в Serial Monitor для отладки
  }

  // Обработка нажатия второй педали
  if (middle == 1) {
    Keyboard.click(KEY_2);  // Отправка нажатия клавиши "2"
    Serial.println("middle_pedal");    // Вывод в Serial Monitor для отладки
  }

  // Обработка нажатия третьей педали
  if (right == 1) {
    Keyboard.click(KEY_3);  // Отправка нажатия клавиши "3"
    Serial.println("right_pedal");    // Вывод в Serial Monitor для отладки
  }
}
